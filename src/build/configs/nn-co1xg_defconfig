## src/build/configs/nn-co1xg_defconfig
```kconfig
CONFIG_MODEL_NNCO1XG=y
CONFIG_NVIDIA=y
CONFIG_NVIDIA_NANO=y
CONFIG_OBU=y
CONFIG_GPS_XSENS=y
CONFIG_GPS_XSENS_MTI_680G=y
CONFIG_SQLITE=y
CONFIG_PLATFORM_OBU_CHEMTRONICS=y
CONFIG_PLATFORM_OBU_CHEMTRONICS_COMPACT=y
CONFIG_RTC=y
CONFIG_EXT_DATA_FORMAT=y
CONFIG_SW_VERSION=2.1
```

## src/build/configs/nn-co2og_defconfig
```kconfig
CONFIG_MODEL_NNCO2OG=y
CONFIG_NVIDIA=y
CONFIG_NVIDIA_JETSON_ORIN=y
CONFIG_NVIDIA_NANO=y
# CONFIG_GPS_XSENS is not set
# CONFIG_GPS_XSENS_MTI_680G is not set
CONFIG_GPS_OBU=y
CONFIG_SQLITE=y
CONFIG_PLATFORM_OBU_CHEMTRONICS=y
CONFIG_PLATFORM_OBU_CHEMTRONICS_COMPACT=y
CONFIG_RTC=y
CONFIG_EXT_DATA_FORMAT=y
CONFIG_SW_VERSION=2.1
```

## src/build/configs/nn-co2xg_defconfig
```kconfig
CONFIG_MODEL_NNCO2XG=y
CONFIG_NVIDIA=y
CONFIG_NVIDIA_NANO=y
CONFIG_GPS_XSENS=y
CONFIG_GPS_XSENS_MTI_680G=y
CONFIG_SQLITE=y
CONFIG_PLATFORM_OBU_CHEMTRONICS=y
CONFIG_PLATFORM_OBU_CHEMTRONICS_COMPACT=y
CONFIG_RTC=y
CONFIG_EXT_DATA_FORMAT=y
CONFIG_SW_VERSION=2.1
```

## src/build/configs/no-co2ogm_defconfig
```kconfig
CONFIG_MODEL_NOCO2XGR=y
CONFIG_NVIDIA=y
CONFIG_NVIDIA_JETSON_ORIN=y
CONFIG_OBU=y
CONFIG_GPS_XSENS=y
CONFIG_GPS_XSENS_MTI_680G=y
CONFIG_SQLITE=y
CONFIG_PLATFORM_OBU_CHEMTRONICS=y
CONFIG_PLATFORM_OBU_CHEMTRONICS_COMPACT=y
CONFIG_RTC=y
CONFIG_ROS=y
CONFIG_EXT_DATA_FORMAT=y
CONFIG_WEBSOCKET=y
CONFIG_OBU_MAX_DEV=4
CONFIG_SW_VERSION=2.1
```

## src/build/configs/nvidia_nano_defconfig
```kconfig
CONFIG_NVIDIA=y
CONFIG_NVIDIA_NANO=y
CONFIG_GPS_XSENS=y
CONFIG_GPS_XSENS_MTI_680G=y
CONFIG_SQLITE=y
CONFIG_PLATFORM_OBU_CHEMTRONICS=y
CONFIG_RTC=y
CONFIG_SW_VERSION=0.7
```

## src/build/configs/nvidia_orin_defconfig
```kconfig
CONFIG_NVIDIA=y
CONFIG_NVIDIA_JETSON_ORIN=y
CONFIG_GPS_XSENS=y
CONFIG_GPS_XSENS_MTI_680G=y
CONFIG_SQLITE=y
CONFIG_PLATFORM_OBU_CHEMTRONICS=y
CONFIG_RTC=y
CONFIG_SW_VERSION=0.3
```

## src/build/configs/ubuntu_20.04_defconfig
```kconfig
CONFIG_UBUNTU=y
CONFIG_UBUNTU_MAJOR_VER=20
CONFIG_UBUNTU_MINOR_VER=04
# CONFIG_GPS_XSENS_MTI_680G is not set
CONFIG_SQLITE=y
CONFIG_PLATFORM_OBU_CHEMTRONICS=y
```

## src/build/configs/ui-co1xg_defconfig
```kconfig
CONFIG_MODEL_UCO1XG=y
CONFIG_UBUNTU=y
CONFIG_UBUNTU_MAJOR_VER=20
CONFIG_UBUNTU_MINOR_VER=04
CONFIG_SQLITE=y
CONFIG_GPS_OBU=y
CONFIG_OBU=y
CONFIG_PLATFORM_OBU_CHEMTRONICS=y
CONFIG_PLATFORM_OBU_CHEMTRONICS_COMPACT=y
CONFIG_RTC=y
CONFIG_WEBSOCKET=y
CONFIG_EXT_DATA_FORMAT=y
CONFIG_SW_VERSION=2.4

# V2X Video Streaming Configuration
CONFIG_VIDEO_STREAMING=y
CONFIG_CAMERA_NVIDIA=y
CONFIG_DISPLAY_NVIDIA=y
CONFIG_VIDEO_CODEC_HW=y
CONFIG_RTSP_SERVER=y
CONFIG_VIDEO_RECORD=y
CONFIG_GSTREAMER=y
```

## src/build/configs/xz-co1xgc_defconfig
```kconfig
CONFIG_MODEL_XZCO1XGC=y
CONFIG_XILINX=y
CONFIG_XILINX_ZCU216=y
# CONFIG_EXT_DATA_FORMAT is not set
CONFIG_SW_VERSION=2.1
```
